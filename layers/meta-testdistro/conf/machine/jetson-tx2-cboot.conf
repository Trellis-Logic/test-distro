## layers/meta-testdistro/conf/machine/jetson-tx2-cboot.conf
```bitbake
SECURITY_OPTIONS ?= ":secureboot:signing"
MACHINEOVERRIDES = "jetson-tx2:${MACHINE}${SECURITY_OPTIONS}"
require conf/machine/jetson-tx2.conf
PACKAGE_EXTRA_ARCHS_append = " jetson-tx2"
PREFERRED_PROVIDER_virtual/bootloader = "cboot-prebuilt"
PARTITION_LAYOUT_TEMPLATE = "flash_${MACHINE}_custom.xml"
ROOTFSPART_SIZE_jetson-tx2-cboot = "6442450944"
INITRD_FSTYPES = "cpio.gz cpio.gz.cboot cpio.gz.cboot.bup-payload"
MACHINE_EXTRA_RDEPENDS += "tegra-boot-tools"
SYSTEMD_DEFAULT_TARGET = "finished-booting.target"
MENDER_DATA_PART_SIZE_MB = "128"
MENDER_STORAGE_DEVICE_BASE = "/dev/mmcblk0p"
MENDER_STORAGE_TOTAL_SIZE_MB = "${@int(d.getVar('EMMC_SIZE')) // 1024 // 1024}"
# Reduce the rootfs size by 10% to allow for cryptfs overhead
MENDER_IMAGE_ROOTFS_SIZE_DEFAULT = "${@int(d.getVar('ROOTFSPART_SIZE')) * 9 // 10240}"
```
